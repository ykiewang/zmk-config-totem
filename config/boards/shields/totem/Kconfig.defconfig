## config/boards/shields/totem/Kconfig.defconfig
```kconfig
# Copyright (c) 2022 The ZMK Contributors
# SPDX-License-Identifier: MIT

if SHIELD_TOTEM_LEFT

config ZMK_KEYBOARD_NAME
    default "TOTEM"
    
config ZMK_SPLIT_ROLE_CENTRAL
    default y

endif

if SHIELD_TOTEM_LEFT || SHIELD_TOTEM_RIGHT

config ZMK_SPLIT
    default y

endif

config ZMK_TOTEM_GATT_STATUS
    bool "Expose keyboard status (layer+mods) over a custom GATT characteristic"
    depends on ZMK_BLE
    default n
```

## config/west.yml
```yaml
manifest:
  remotes:
    - name: zmkfirmware
      url-base: https://github.com/zmkfirmware
    - name: ykiewang
      url-base: https://github.com/ykiewang
  projects:
    - name: zmk
      remote: zmkfirmware
      revision: main
      import: app/west.yml
    - name: zmk-keybeacon
      remote: ykiewang
      revision: feat/005-host-link-profile-awareness
  self:
    path: config
```

## modules/zmk-gatt-layer-probe/Kconfig
```kconfig
config ZMK_GATT_LAYER_PROBE
    bool "Enable GATT layer probe (custom UUID test)"
    depends on ZMK_BLE
    default n
    help
      Exposes a fake layer value via a custom 128-bit GATT service.
      For Step-1 validation of custom UUID discovery/read/notify on macOS.
      Uses pure Zephyr BT API (no ZMK internal headers).
```
